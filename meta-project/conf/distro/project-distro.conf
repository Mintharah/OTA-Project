## meta-project/conf/distro/project-distro.conf
```bitbake
requires conf/distro/poky.conf

DISTRO = "meta-project-distro"
DISTRO_NAME = "Meta Project (:"
DISTRO_VERSION = "1.0"
DISTRO_CODENAME = "scarthgap"

#Init Manager
DISTRO_FEATURES:append = " systemd"
DISTRO_FEATURES_BACKFILL_CONSIDERED += "sysvinit"
VIRTUAL-RUNTIME_init_manager = "systemd"
VIRTUAL-RUNTIME_initscripts = "systemd-compat-units"

#Networking & IPC
DISTRO_FEATURES:append = " dbus ipv4 ipv6"

#Removing things you dont need to keep image small
DISTRO_FEATURES:remove = " x11 wayland vulkan opengl"
```
